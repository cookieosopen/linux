## drivers/cookieos/Kconfig
```kconfig
menu "CookieOS Drivers"

config COOKIEOS_PROC
    bool "CookieOS shared proc interface"
    depends on PROC_FS
    default y
    help
      Enable the shared /proc/cookieos interface
      for CookieOS drivers.

comment "Modular Technology configuration"
source "drivers/cookieos/mt/Kconfig"

endmenu
```

## drivers/cookieos/mt/Kconfig
```kconfig
menu "CookieOS MT specific drivers"

config MT_MTCORE
    tristate "MtCore"
    default m
    help
      MtCore.

endmenu
```
